## firmware/esp32/main/Kconfig.projbuild
```kconfig
menu "IoTKit Configuration"

    config IOTKIT_LED_PIN
        int "Onboard LED GPIO Pin"
        default 8
        help
            GPIO pin number for the onboard LED.
            ESP32-C61-DevKitC-1 uses GPIO 8 for the WS2812 RGB LED.

    config IOTKIT_LED_IS_ADDRESSABLE
        bool "LED is addressable (WS2812/NeoPixel)"
        default y if IDF_TARGET_ESP32C61
        default y if IDF_TARGET_ESP32C3
        default n
        help
            Enable if the onboard LED is an addressable RGB LED (WS2812).
            Per-board defaults (override via CONFIG_IOTKIT_LED_PIN in the matching
            sdkconfig.defaults.<target> file): ESP32-C61-DevKitC-1 uses GPIO 5;
            ESP32-C3-DevKitM-1 uses GPIO 8.

endmenu
```

## firmware/esp32/sdkconfig.defaults
```kconfig
CONFIG_IDF_TARGET="esp32"
CONFIG_IOTKIT_LED_PIN=2
CONFIG_PARTITION_TABLE_CUSTOM=y
CONFIG_PARTITION_TABLE_CUSTOM_FILENAME="partitions.csv"
CONFIG_ESP_TLS_USING_MBEDTLS=y
CONFIG_MBEDTLS_CERTIFICATE_BUNDLE=y
CONFIG_MBEDTLS_CERTIFICATE_BUNDLE_DEFAULT_FULL=y
CONFIG_WS_BUFFER_SIZE=2048
# Resolve `<server>.local` over mDNS so devices flashed with e.g.
# `devicesdk.local:8080` reach the self-hosted server without a static IP.
# This routes one-shot `.local` lookups through the standard lwIP resolver
# (used by esp_websocket_client); IGMP is enabled by default in ESP-IDF lwIP.
CONFIG_LWIP_DNS_SUPPORT_MDNS_QUERIES=y
```

## firmware/esp32/sdkconfig.defaults.esp32c3
```kconfig
CONFIG_IDF_TARGET="esp32c3"
CONFIG_DEVICESDK_LED_PIN=8
CONFIG_PARTITION_TABLE_CUSTOM=y
CONFIG_PARTITION_TABLE_CUSTOM_FILENAME="partitions.csv"
```

## firmware/esp32/sdkconfig.defaults.esp32c61
```kconfig
CONFIG_IDF_TARGET="esp32c61"
CONFIG_DEVICESDK_LED_PIN=5
CONFIG_PARTITION_TABLE_CUSTOM=y
CONFIG_PARTITION_TABLE_CUSTOM_FILENAME="partitions.csv"
```
